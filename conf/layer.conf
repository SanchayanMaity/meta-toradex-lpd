## conf/layer.conf
```bitbake
BBPATH .= ":${LAYERDIR}"
BBFILES += "${LAYERDIR}/recipes-*/*/*.bb \
    ${LAYERDIR}/recipes-*/*/*.bbappend"
BBFILE_COLLECTIONS += "toradex-lpd"
BBFILE_PATTERN_toradex-lpd = "^${LAYERDIR}/"
BBFILE_PRIORITY_toradex-lpd = "97"
```
